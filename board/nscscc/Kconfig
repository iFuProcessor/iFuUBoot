## board/nscscc/Kconfig
```kconfig
if TARGET_TRIVIALMIPS_NSCSCC

config SYS_BOARD
    default "2019"

config SYS_VENDOR
    default "nscscc"

config SYS_CONFIG_NAME
    default "trivialmips_nscscc"

config SYS_TEXT_BASE
    default 0x80000000

endif

if TARGET_MEGASOC_DEMO

config SYS_BOARD
    default "2019"

config SYS_VENDOR
    default "nscscc"

config SYS_CONFIG_NAME
    default "megasoc_demo"

config SYS_TEXT_BASE
    default 0xBC000000

endif

if TARGET_LA32R_LOONGSONSOC_DEMO

config SYS_BOARD
    default "2019"

config SYS_VENDOR
    default "nscscc"

config SYS_CONFIG_NAME
    default "la32rsoc_demo"

config SYS_TEXT_BASE
    default 0xBC000000

endif

if TARGET_LA32R_BAIXINMEGA_DEMO

config SYS_BOARD
    default "2019"

config SYS_VENDOR
    default "nscscc"

config SYS_CONFIG_NAME
    default "la32rmegasoc_demo"

config SYS_TEXT_BASE
    default 0xBC000000

endif
```
